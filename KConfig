## KConfig
```kconfig
menu "SFM3003"    
    config SFM3003_LOG_LEVEL
        int "Log level (1=ERR, 2=WARN, 3=INFO, 4=DEBUG). Limited by global LOG_MAXIMUM_LEVEL."
        default 3
        range 1 4

    config SFM_LP_BUFF_LEN
        int "Number of slots in LP ring buffers"
        default 32
        range 5 64
endmenu
```
